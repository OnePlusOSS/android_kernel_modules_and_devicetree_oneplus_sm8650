/dts-v1/;
/plugin/;

#include <dt-bindings/interrupt-controller/arm-gic.h>
#include <dt-bindings/soc/qcom,ipcc.h>
#include <dt-bindings/interconnect/qcom,cliffs.h>
#include <dt-bindings/clock/qcom,videocc-pineapple.h>
#include <dt-bindings/clock/qcom,gcc-cliffs.h>
#include <dt-bindings/arm/msm/qti-smmu-proxy-dt-ids.h>
#include "cliffs-eva.dtsi"

/ {
	model = "Qualcomm Technologies, Inc. cliffs";
	compatible = "qcom,cliffs";
	qcom,msm-id = <614 0x10000>;
	qcom,board-id = <0 0>;
};
