&oplus_cpa {
	/* format: <protocol_type power_w> */
	oplus,protocol_list = <CHG_PROTOCOL_VOOC 100
			       CHG_PROTOCOL_PPS  33
			       CHG_PROTOCOL_PD   18
			       CHG_PROTOCOL_QC   18>;
	oplus,default_protocol_list = <CHG_PROTOCOL_PD
				       CHG_PROTOCOL_PPS
				       CHG_PROTOCOL_VOOC>;
};
