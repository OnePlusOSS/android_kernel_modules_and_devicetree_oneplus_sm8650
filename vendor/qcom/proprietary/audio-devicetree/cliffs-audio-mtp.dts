/dts-v1/;
/plugin/;

#include "cliffs-audio-mtp.dtsi"
 / {
	model = "Qualcomm Technologies, Inc. Cliffs MTP";
	compatible = "qcom,cliffs-mtp", "qcom,cliffs", "qcom,mtp";
	qcom,msm-id = <614 0x10000>;
	qcom,board-id = <8 0>;
};
