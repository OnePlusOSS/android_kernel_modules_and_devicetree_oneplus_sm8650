/dts-v1/;
/plugin/;
#include <dt-bindings/oplus/hw-id.h>
#include "../pineapple-audio-mtp.dts"
#include "pineapple-audio-overlay-common.dtsi"
#include "enzo-23607-audio-pineapple-overlay.dtsi"

/ {
    model = "Qualcomm Technologies, Inc. Pineapple MTP,enzo";

    oplus,project-id = <23607>;
};
