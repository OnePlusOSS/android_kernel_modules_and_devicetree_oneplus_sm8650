/dts-v1/;
/plugin/;

#include "kalama-v2-ese-common.dtsi"

/ {
    model = "Qualcomm Technologies, Inc. Kalama MTP";
    compatible = "qcom,kalama-mtp", "qcom,kalama", "qcom,mtp";
    qcom,msm-id = <557 0x20000>;
    qcom,board-id = <0x50008 0>;
};
