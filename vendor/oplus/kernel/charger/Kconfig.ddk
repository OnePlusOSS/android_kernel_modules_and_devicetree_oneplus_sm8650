## vendor/oplus/kernel/charger/v2/Kconfig
```kconfig
source "$(KCONFIG_EXT_PREFIX)drivers/power/oplus/v2/ufcs/Kconfig"

config OPLUS_CHG_IC_DEBUG
	bool "Virtual IC layer debug interface"
	help
	  Say Y here to declare virtual IC layer debug interface

config OPLUS_FEATURE_CHG_IC_VIRTUAL
	bool "Virtual IC layer IC virtualization support"
	depends on OPLUS_CHG_IC_DEBUG
	help
	  Say Y here to enable

config OPLUS_CHG_MMS_DEBUG
	bool "Message subscription layer debug interface"
	help
	  Say Y here to declare message subscription layer debug interface

config OPLUS_CHG_MMS_PUBLISH_USERSPACE
	bool "Deliver messages to user space through uevent"
	default n
	help
	  Say Y to enable

config OPLUS_DEBUG_AUTH
	bool "Debug authentication"
	default n
	help
	  Say Y to enable debug authentication

config OPLUS_SMART_CHARGE
	bool "smart charge"
	help
	  Say Y here to enable smart charge

config DISABLE_OPLUS_FUNCTION
	bool "DISABLE_OPLUS_FUNCTION for bringup compile"
	default n
	help
	  Say Y to include support

config OPLUS_CHG_DRM_PANEL_NOTIFY
	bool "OPLUS_CHG_DRM_PANEL_NOTIFY"
	default n
	help
	  Say Y to include support

config OPLUS_DA9313_CHARGER
	bool "DA9313 support"
	help
	  Say Y here to declare DA9313 support

config OPLUS_MP2762_CHARGER
	bool "MP2762 support"
	help
	  Say Y here to declare MP2762 support

config OPLUS_SGM41512_CHARGER
	bool "SGM41512 support"
	help
	  Say Y here to declare SGM41512 support

config OPLUS_SC6607_CHARGER
	bool "SC6607_CHARGER support"
	help
	  Say Y here to declare SC6607_CHARGER support

config OPLUS_SC6607_CP
	bool "SC6607_CP support"
	help
	  Say Y here to declare SC6607_CP support

config OPLUS_SC6607_UFCS
	bool "SC6607_UFCS support"
	help
	  Say Y here to declare SC6607_UFCS support
config OPLUS_SY6974B_CHARGER
	bool "SY6974B support"
	help
	  Say Y here to declare SY6974B support

config OPLUS_SGM41515_CHARGER
        bool "SGM41515 support"
        help
          Say Y here to declare SGM41515 support

config OPLUS_PD_MANAGER_CHARGER
	bool "PD_MANAGER support"
	help
	  Say Y here to declare PD_MANAGER support

config OPLUS_ADSP_CHARGER
	bool "ADSP support"
	help
	  Say Y here to declare ADSP support

config OPLUS_MT6375_CHARGER
	bool "MT6375 debug support"
	help
	  Say Y here to declare MT6375 debug support

config OPLUS_MT6379_CHARGER
	bool "PMIC MT6379 support"
	help
	  Say Y here to declare PMIC MT6379 support

config OPLUS_MT6789_CHARGER
	bool "MTK6789 support"
	help
	  Say Y here to declare MTK6789 support

config OPLUS_MT6835_CHARGER
        bool "MTK6835 support"
        help
          Say Y here to declare MTK6835 support

config OPLUS_GAUGE_MPC7022
	bool "GAUGE MPC7022 support"
	default n
	help
	  Say Y here to declare GAUGE MPC7022 support

config OPLUS_GAUGE_BQ27Z561
	bool "GAUGE BQ27Z561 support"
	help
	  Say Y here to declare GAUGE BQ27Z561 support

config OPLUS_GAUGE_SN28Z729
	bool "GAUGE SN28Z729 support"
	help
	  Say Y here to declare GAUGE SN28Z729 support

config OPLUS_GAUGE_NFG8011B
	bool "GAUGE NFG8011B support"
	help
	  Say Y here to declare GAUGE NFG8011B support

config OPLUS_GAUGE_CW2217B
	bool "GAUGE CW2217B support"
	help
	  Say Y here to declare GAUGE CW2217B support

config OPLUS_ADSP_SM8450_CHARGER
	bool "SM8450 support"
	help
	  Say Y here to declare sm8450 support

config OPLUS_CHG_PARALLEL
	bool "parallel battery switching support"
	help
	  Say Y here to declare parallel battery switching support

config OPLUS_CHG_MOS_CTRL
	bool "parallel mos ctrl support"
	help
	  Say Y here to declare parallel mos ctrl support

config OPLUS_FG_ERROR_RESET_I2C
	bool "FG error reset I2C support"
	help
	  Say Y here to declare FG error actively call I2C reset function

config OPLUS_VOOCPHY_SC8547A
	bool "oplus voocphy sc8547a support"
	help
	  Say Y here to declare cp sc8547a support

config OPLUS_UFCS_SC2201
	bool "enable sc2201 ufcs phy"
	depends on OPLUS_UFCS_CLASS
	help
	  Say Y here to declare sc2201 ufcs phy support

config OPLUS_UFCS_SC8547A
	bool "enable sc8547a ufcs phy"
	depends on OPLUS_UFCS_CLASS
	help
	  Say Y here to declare sc8547a ufcs phy support

config OPLUS_PHY_SC8547D
	bool "enable sc8547d voocphy && ufcs phy"
	depends on OPLUS_UFCS_CLASS
	help
	  Say Y here to declare sc8547d voocphy && ufcs phy support

config OPLUS_WIRELESS_NU1619
	bool "oplus wireless nu1619 support"
	help
	  Say Y here to declare wireless nu1619 support

config OPLUS_WIRELESS_NU1669
	bool "oplus wireless nu1669 support"
	help
	  Say Y here to declare wireless nu1669 support

config OPLUS_WIRELESS_P9415
	bool "oplus wireless p9415 support"
	help
	  Say Y here to declare wireless p9415 support

config OPLUS_WIRELESS_SC96257
	bool "oplus wireless sc96257 support"
	help
	  Say Y here to declare wireless sc96257 support

config OPLUS_CHARGEPUMP_HL7227
	bool "oplus chargepump hl7227 support"
	help
	  Say Y here to declare chargepump hl7227 support

config OPLUS_BATT_BAL
	bool "series battery balance support"
	help
	  Say Y here to declare series battery balance support

config OPLUS_SY6603_BATT_BAL
	bool "sy6603 support"
	help
	  Say Y here to declare sy6603 support

config OPLUS_SC7637_LEVEL_SHIFT
	bool "sc7637 support"
	help
	  Say Y here to declare sc7637 support
config OPLUS_TPS6128XD_CHARGER
	bool "tps6128xd support"
	help
	  Say Y here to declare tps6128xd support
config OPLUS_HL7603_CHARGER
	bool "hl7603 support"
	help
	  Say Y here to declare hl7603 support

menuconfig OPLUS_CHG_RECOVERY
	bool "oplus charge recovery module"
	help
	  Say Y here to enable oplus charge recovery module

if OPLUS_CHG_RECOVERY
config OPLUS_CHG_STATE_KEEP
	bool "state keep support"
	help
	  Say Y here to enable state keep support
endif #OPLUS_CHG_RECOVERY

menuconfig OPLUS_CHG_VOOCPHY
	bool "OPLUS charging voocphy"
	help
	  Say Y here to enable OPLUS charging system support

if OPLUS_CHG_VOOCPHY
config OPLUS_CHG_VOOCPHY_CHGLIB
	bool "voocphy chglib support"
	help
	  Say Y here to declare voocphy chglib support

config OPLUS_CHG_AP_VOOCPHY
	bool "ap voocphy support"
	depends on OPLUS_CHG_VOOCPHY_CHGLIB
	help
          Say Y here to declare ap voocphy support

config OPLUS_CHG_ADSP_VOOCPHY
	bool "adsp voocphy support"
	depends on OPLUS_CHG_VOOCPHY_CHGLIB
	help
          Say Y here to declare adsp voocphy support

config OPLUS_VOOCPHY_MASTER_SC8547
	bool "master cp sc8547 support"
	depends on OPLUS_CHG_VOOCPHY_CHGLIB && OPLUS_CHG_AP_VOOCPHY
	help
	  Say Y here to declare master cp sc8547 support

config OPLUS_VOOCPHY_SLAVE_SC8547
	bool "slave cp sc8547 support"
	depends on OPLUS_CHG_VOOCPHY_CHGLIB && OPLUS_CHG_AP_VOOCPHY
	help
	  Say Y here to declare slave cp sc8547 support

config OPLUS_VOOCPHY_SC8517
	bool "bidirect cp sc8517 support"
	depends on OPLUS_CHG_VOOCPHY_CHGLIB && OPLUS_CHG_AP_VOOCPHY
	help
	  Say Y here to declare bidirect cp sc8517 support

config OPLUS_VOOCPHY_MAX77939
	bool "bidirect cp max77939 support"
	depends on OPLUS_CHG_VOOCPHY_CHGLIB && OPLUS_CHG_AP_VOOCPHY
	help
	  Say Y here to declare bidirect cp max77939 support

config OPLUS_AUDIO_SWITCH_GLINK
	bool "audio switch glink support"
	help
	  Say Y here to declare audio switch glink support

config OPLUS_VOOCPHY_HL7138
	bool "cp hl7138 support"
	depends on OPLUS_CHG_VOOCPHY_CHGLIB && OPLUS_CHG_AP_VOOCPHY
	help
	  Say Y here to declare cp hl7138 support

config OPLUS_VOOCPHY_SLAVE_HL7138
        bool "cp hl7138 support"
        depends on OPLUS_CHG_VOOCPHY_CHGLIB && OPLUS_CHG_AP_VOOCPHY
        help
          Say Y here to declare slave cp hl7138 support

config OPLUS_UFCS_MASTER_NU2112A
	bool "master cp nu2112A support"
	depends on OPLUS_UFCS_CLASS && OPLUS_CHG_VOOCPHY_CHGLIB && OPLUS_CHG_AP_VOOCPHY
	help
	  Say Y here to declare master cp nu2112A support

config OPLUS_UFCS_SLAVE_NU2112A
	bool "slave cp nu2112A support"
	depends on OPLUS_UFCS_CLASS && OPLUS_CHG_VOOCPHY_CHGLIB && OPLUS_CHG_AP_VOOCPHY
	help
	  Say Y here to declare slave cp nu2112A support

config OPLUS_CHARGER_OPTIGA
	bool "OPLUS OPTIGA soc node"
	help
	  Say Y to include support

config OPLUS_CHARGER_MAXIM
	bool "encryption ic maxim support"
	help
	  Say Y here to declare encryption ic maxim support

config OPLUS_TPS6128XD_CHARGER
	bool "tps6128xd support"
	help
	  Say Y here to declare tps6128xd support

config OPLUS_STATE_RETENTION
	bool "enable state retention support"
	help
	  Say Y here to declare state retention support

config OPLUS_SEC_IC_SC5891
        bool "encryption ic sc5891 support"
        default n
        help
          Say Y here to declare encryption ic sc5891 support

endif #OPLUS_CHG_VOOCPHY

config OPLUS_LIQUID_DETECTION
	bool "liquid detection support"
	help
	  Say Y here to declare liquid detection support

config OPLUS_CANCEL_USB_SWITCH
	bool "cancel usb switch support"
	help
	  Say Y here to declare cancel usb switch support
```

## vendor/oplus/kernel/patch/Kconfig
```kconfig
# SPDX-License-Identifier: GPL-2.0-only
# Copyright (C) 2023-2030 Oplus. All rights reserved.

config OPLUS_PATCH
    tristate "Oplus Kernel Patch"
    default n
    help
      This option enables support for Oplus Kernel Patch.
```

## vendor/oplus/kernel/tp/hbp/hbp/Kconfig
```kconfig
config TOUCHSCREEN_HBP_CORE
    tristate "Oplus Touchscreen"
    default n
    help
      Say Y here if you have Focaltech touch panel.
      If unsure, say N.

source "drivers/input/touchscreen/tp_hbp/chips/focal/ft3683g/Kconfig"
source "drivers/input/touchscreen/tp_hbp/chips/focal/ft3685g/Kconfig"
source "drivers/input/touchscreen/tp_hbp/chips/synaptics/s3910/Kconfig"
```
