## vendor/oplus/kernel/boot/bootloader_log/Kconfig
```kconfig
# SPDX-License-Identifier: GPL-2.0-only
# Copyright (C) 2018-2020 Oplus. All rights reserved.

config OPLUS_FEATURE_BOOTLOADER_LOG
	tristate "show bootloader log"
	default n
	help
	  show bootloader log in kernel
```

## vendor/oplus/kernel/boot/htb/Kconfig
```kconfig
# SPDX-License-Identifier: GPL-2.0

config TANGO32
	tristate "32-bit syscall support for the Tango binary translator"
	depends on 64BIT && COMPAT
	help
	This driver exposes 32-bit compat syscalls to 64-bit processes. It is
	intended for the use of the Tango binary translator.
```

## vendor/oplus/kernel/cpu/Kconfig
```kconfig
# SPDX-License-Identifier: GPL-2.0-only
# Copyright (C) 2018-2022 Oplus. All rights reserved.

source "$(KCONFIG_EXT_PREFIX)drivers/soc/oplus/cpu/cpufreq_health/Kconfig"
source "$(KCONFIG_EXT_PREFIX)drivers/soc/oplus/cpu/cpufreq_bouncing/Kconfig"
source "$(KCONFIG_EXT_PREFIX)drivers/soc/oplus/cpu/sched/Kconfig"
source "$(KCONFIG_EXT_PREFIX)drivers/soc/oplus/cpu/uad/Kconfig"
source "$(KCONFIG_EXT_PREFIX)drivers/soc/oplus/cpu/oplus_omrg/Kconfig"
source "$(KCONFIG_EXT_PREFIX)drivers/soc/oplus/cpu/oplus_overload/Kconfig"
```

## vendor/oplus/kernel/cpu/sched/Kconfig
```kconfig
# Copyright (C) 2018-2020 Oplus. All rights reserved.

config OPLUS_FEATURE_PERFORMANCE_SCHED
	bool "config oplus kernel sched feature"
	default y
	help
	  define this config to add oplus kernel sched feature

config OPLUS_FEATURE_SCHED_ASSIST
	tristate "sched assist"
	default n
	help
	  turning sched for ui, render and so on to improve UX

config OPLUS_FEATURE_SF_BOOST
	tristate "sf boost"
	default n
	help
	  When the util of surfaceflinger is greater than 90,
	  prefer to use big core.

config OPLUS_FEATURE_HEALTHINFO
	tristate "config healthinfo"
	default n
	depends on OPLUS_FEATURE_PERFORMANCE_SCHED
	help
	  define this config to init  healthinfo.

config OPLUS_FEATURE_TASK_CPUSTATS
	tristate "task_cpustats"
	default n
	help
	  record cpu status

config OPLUS_FEATURE_SCHED_SPREAD
	bool "sched spread"
	default n
	depends on OPLUS_FEATURE_SCHED_ASSIST
	depends on CGROUP_SCHED
	help
	  This is the uifirst 5.0 feature, which will spread tasks,
	  kick runnable time from task demand.

config OPLUS_FEATURE_TASK_SCHED
	tristate "task_sched"
	default n
	depends on OPLUS_FEATURE_SCHED_ASSIST
	help
	  record task sched info

config OPLUS_FEATURE_TASK_LOAD
	tristate "task_load"
	default n
	depends on OPLUS_FEATURE_SCHED_ASSIST
	help
	  record cpu and task load

config OPLUS_SCHED_TUNE
	bool "Boosting for CFS tasks (EXPERIMENTAL)"
	default n
	help
	  This option enables support for task classification using a new
	  cgroup controller, schedtune. Schedtune allows tasks to be given
	  a boost value and marked as latency-sensitive or not. This option
	  provides the "schedtune" controller.

	  This new controller:
	  1. allows only a two layers hierarchy, where the root defines the
	     system-wide boost value and its direct childrens define each one a
	     different "class of tasks" to be boosted with a different value
	  2. supports up to 16 different task classes, each one which could be
	     configured with a different boost value

	  Latency-sensitive tasks are not subject to energy-aware wakeup
	  task placement. The boost value assigned to tasks is used to
	  influence task placement and CPU frequency selection (if
	  utilization-driven frequency selection is in use).

	  If unsure, say N.

config OPLUS_FEATURE_LOADBALANCE
	bool "oplus loadbalance"
	default n
	depends on OPLUS_FEATURE_SCHED_ASSIST
	help
	  This is the uifirst 6.0 feature about loadbalance.

config OPLUS_FEATURE_PIPELINE
	bool "oplus pipeline"
	default n
	depends on OPLUS_FEATURE_SCHED_ASSIST
	help
	  hint game critical threads to run on some specific cpus.

config OPLUS_FEATURE_TICK_GRAN
	bool "oplus tick granularity"
	default n
	depends on OPLUS_FEATURE_SCHED_ASSIST
	help
	  adjust the granularity for accounting in ticks

config OPLUS_SCHED_MT6895
	bool "mt6895 specific sched feature"
	default n
	help
	  the difference between the mainline currently is whether to
	  skip the CPU where the ux task is located when the RT task
	  selects a new cpu core.
	  rt tasks have "affinity with" prev running cpu, this only
	  takes effect when a new core is selected.

config OPLUS_FEATURE_CPU_JANKINFO
	tristate "config oplus_schedinfo"
	default n
	depends on OPLUS_FEATURE_PERFORMANCE_SCHED
	help
	  define this config to enable oplus_schedinfo.

config OPLUS_PERF_SCHEDINFO
	tristate "config oplus_perf_schedinfo"
	depends on OPLUS_FEATURE_CPU_JANKINFO
	default n
	help
	  cpu sched info
config OPLUS_PROCS_LOAD_STATE
        tristate "config oplus_procs_load_state"
        depends on OPLUS_FEATURE_CPU_JANKINFO
        default n
        help
          oplus power procs load


config OPLUS_FEATURE_FRAME_BOOST
	tristate "frame boost"
	default n
	depends on OPLUS_FEATURE_PERFORMANCE_SCHED
	help
	  This moduler is used to improve frame missing by aggregating key-threads in one group,
	  then adjust cpu frequence and placement.

config OPLUS_FEATURE_SF_SLIDE_BOOST
	tristate "sf slide boost"
	default n
	depends on OPLUS_FEATURE_SCHED_ASSIST
	depends on OPLUS_FEATURE_FRAME_BOOST
	help
	  Only applicable to SM6375 camry, when animation, gpu composition and slide scenes,
	  surfaceflinger prefer to use big core.

config OPLUS_CPU_AUDIO_PERF
	tristate "boost audio task in scheduler"
	default n
	help
	   Choose this option to enable scheduler boost for audio task.
config LOCKING_PROTECT
	bool "locking protect"
	depends on OPLUS_FEATURE_SCHED_ASSIST
	default n
	help
	   protect locking protect.
config PCPU_RWSEM_LOCKING_PROTECT
	bool "percpu-rwsem locking protect"
	depends on LOCKING_PROTECT
	default n
	help
	   percpu-rwsem protect locking protect.

config OPLUS_RWSEM_RSPIN
	bool "rwsem_rspin"
	default n
	help
	  Support rwsem reader optimistic spin.

config OPLUS_FEATURE_BAN_APP_SET_AFFINITY
	bool "config ban app set affinity"
	default n
	help
	  ban app set affinity

config OPLUS_ADD_CORE_CTRL_MASK
	bool "config add core_ctrl mask"
        default n
        help
          consider core_ctrl mask

config OPLUS_FEATURE_EAS_OPT
	tristate "eas opt"
	default n
	help
	  control oplus_cap, iowait_protect

config OPLUS_FEATURE_VT_CAP
	tristate "fake cap"
	default n
	depends on OPLUS_FEATURE_EAS_OPT
	help
	  fake cap can influence task placement

config OPLUS_CPUFREQ_IOWAIT_PROTECT
	tristate "cpufreq_iowait"
	default n
	depends on OPLUS_FEATURE_EAS_OPT
	help
		ensure iowait decay not happen too quickly

config OPLUS_CAMERA_UX
 	bool "config camera ux"
 	default n
 	help
 	  config camera ux.

config OPLUS_FEATURE_CEILING_FREE
	tristate "ceiling free"
	default n
	help
		set cb/omrg max frequency to default when user touch screen.

config OPLUS_FEATURE_AUDIO_OPT
	tristate "camera optimization in audio mode"
	default n
	help
	  "Turning off the camera's ux attribute in audio mode"

config OPLUS_FEATURE_SCHED_DDL
	bool "sched deadline"
	default y
	help
		normal cfs tasks worst sched latency optimization

config OPLUS_SCHED_HALT_MASK_PRT
	tristate "print cpu halt_mask partial_halt_mask and parse_client"
	default n
	depends on OPLUS_SYSTEM_KERNEL_QCOM
	help
	  cpu halt_mask partial_halt_mask and parse_client

config OPLUS_FEATURE_SKIP_CAMERA_UX
	tristate "skip camera ux tick by node"
	default n
	help
	  Turning off the camera's ux attribute by node

config OPLUS_FEATURE_QOS_SCHED
	tristate "Qos Level Control for thread"
	default n
	help
	  This option allows to apply qos level for thread in scheduler.

config OPLUS_SCHED_GROUP_OPT
	bool "Oplus sched group optimization"
	depends on FAIR_GROUP_SCHED
	default FAIR_GROUP_SCHED

config OPLUS_CPU_SKIP_ROTATION
	bool "oplus cpu skip rotation"
	default n
	depends on OPLUS_FEATURE_SCHED_ASSIST
	help
	  rotation need skip ux thread.
```

## vendor/oplus/kernel/storage/storage_feature_in_module/Kconfig
```kconfig
source "drivers/soc/oplus/storage/common/storage_log/Kconfig"
source "drivers/soc/oplus/storage/common/oplus_uprobe/Kconfig"
source "drivers/soc/oplus/storage/common/ufs_oplus_dbg/Kconfig"
source "drivers/soc/oplus/storage/common/oplus_f2fslog_storage/Kconfig"
source "drivers/soc/oplus/storage/common/wq_dynamic_priority/Kconfig"
source "drivers/soc/oplus/storage/common/file_record/Kconfig"
source "drivers/soc/oplus/storage/common/iolimit/Kconfig"
source "drivers/soc/oplus/storage/common/io_monitor/Kconfig"
source "drivers/soc/oplus/storage/common/oplus_resctrl/Kconfig"
```

## vendor/oplus/kernel/storage/storage_feature_in_module/common/io_monitor/Kconfig
```kconfig
config OPLUS_FEATURE_IO_MONITOR
    tristate "io monitor"
    default n
    help
      Monitor Process file read/write.
```

## vendor/oplus/kernel/storage/storage_feature_in_module/common/oplus_resctrl/Kconfig
```kconfig
config OPLUS_RESCTRL
	tristate "oplus resctrl module"
	depends on BLOCK
	default y
	help
	  Support oplus resctrl

config OPLUS_RESCTRL_DEBUG
	bool "oplus resctrl debug"
	depends on OPLUS_RESCTRL
	default n
	help
	  use oplus resctrl debug log
```
