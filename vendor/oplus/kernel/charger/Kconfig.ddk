## vendor/oplus/kernel/charger/Kconfig.ddk
```kconfig
menuconfig OPLUS_CHARGER
	bool "OPLUS charging system"
	depends on I2C
	select REGMAP_I2C
	help
	  Say Y here to enable OPLUS charging system support

if OPLUS_CHARGER
config OPLUS_CHARGER_DDK_BUILD
	bool "oplus charger module build by ddk"
	default y
	help
	  Say Y to support ddk build

config OPLUS_CHARGER_MTK
	bool "OPLUS charger on MTK"
	help
	  Say Y here to declare charging system is on MTK

config OPLUS_HVDCP_SUPPORT
        bool "OPLUS_HVDCP_SUPPORT"
        default n
        help
          Set yes to support mtk hvdcp.

config OPLUS_4400MV_BATTERY_SUPPORT
	bool "OPLUS_CHECK_CHARGERID_VOLT"
	default n
	help
	  Set yes to support BATTERYID features
	  smart battery.
	  Set No to disable BATTERYID features
	  smart battery.

config OPLUS_CHIP_SOC_NODE
        bool "OPLUS chip soc node"
        help
          Say Y to include support

config MTK_KERNEL_POWER_OFF_CHARGING
	bool "MTK kernel power off charging"
	default n
	help
	  yes : support KPOC feature, power off charging would running by
	  kernel and charging animation by kpoc service. no: not support KPOC
	  feature.
	  device won't enter charging mode if config is no.

config OPLUS_MTK_DRM_GKI_NOTIFY_CHG
	default n
	tristate "chg mtk gki notify"

config DISABLE_OPLUS_FUNCTION
	bool "CONFIG_DISABLE_OPLUS_FUNCTION"
	default n
	help
	  Say Y to include supports

config OPLUS_CALL_MODE_SUPPORT
	bool "OPLUS call mode support"
	help
	  Say Y to include support

config OPLUS_SMART_CHARGER_SUPPORT
	bool "OPLUS smart charger support"
	help
	  Say Y to include support

config OPLUS_RTC_DET_SUPPORT
	bool "OPLUS RTC DET SUPPORT"
	default n
	help
	  Say Y to include support

config OPLUS_CHECK_CHARGERID_VOLT
	bool "OPLUS CHECK CHARGERID VOLT"
	default n
	help
	  Say Y to include support

config OPLUS_SHIP_MODE_SUPPORT
	bool "OPLUS_SHIP_MODE_SUPPORT"
	default n
	help
	  Say Y to include support

config OPLUS_CHG_DYNAMIC_CONFIG
	bool "OPLUS_CHG_DYNAMIC_CONFIG"
	default n
	help
	  Say Y to include support

config OPLUS_CHARGER_MTK6877
	bool "OPLUS_CHARGER_MTK6877"
	default n
	help
	  Set yes to support OPLUS_CHARGER_MTK6877 features
	  smart battery.
	  Set No to disable OPLUS_CHARGER_MTK6877 features
	  smart battery.

config OPLUS_CHARGER_MTK6833
	bool "OPLUS_CHARGER_MTK6833"
	default n
	help
	  Set yes to support OPLUS_CHARGER_MTK6833 features
	  smart battery.
	  Set No to disable OPLUS_CHARGER_MTK6833 features
	  smart battery.
config OPLUS_SHORT_HW_CHECK
	bool "OPLUS batt HW SHORT "
	help
	  Say Y here to declare charging system is on MTK

config OPLUS_CHARGER_MTK6769R
	bool "OPLUS_CHARGER_MTK6769R"
	default n
	help
	  Set yes to support OPLUS_CHARGER_MTK6769R features
	  smart battery.
	  Set No to disable OPLUS_CHARGER_MTK6769R features
	  smart battery.

config CHARGER_SC6607
        bool "Charger Driver for SC6607 Charger IC"
        default n
        depends on MTK_CHARGER
        help
          Say Yes to enable SC6607 driver.
          It depends on config MTK_CHARGER.

config OPLUS_CHARGER_MTK_CHGIC
        bool "OPLUS_CHARGER_MTK_CHG_IC"
        default n
        help
          Say Yes to use MTK platform charger ic
          Say No to use extern charger ic

config OPLUS_PD_SOURCECAP_UPDATE_SUPPORT
        tristate "support pps sourcecap update"
        default n
        help
          Say Y to support PD pps sourcecap update function
          Say N to disable

config OPLUS_FEATURE_FEEDBACK
        tristate "Oplus system feedback"
        default n
        help
          define this config to init oplus system feedback.

config OPLUS_MAGCVR_NOTIFY
	tristate "OPLUS_MAGCVR_NOTIFY"
	default n
	help
	  define this config to open magcvr notify

menuconfig OPLUS_CHG
	tristate "OPLUS CHARGER KO module"
	default n
depends on I2C
	select REGMAP_I2C
	help
	  Enables support for the oplus charging v1 framework

source "$(KCONFIG_EXT_PREFIX)v1/Kconfig.ddk"

menuconfig OPLUS_CHG_V2
	tristate "OPLUS charging V2 system"
	default n
	depends on I2C
	select REGMAP_I2C
	help
	  Enables support for the oplus charging v2 framework

if OPLUS_CHG_V2
source "$(KCONFIG_EXT_PREFIX)v2/Kconfig.ddk"
endif

if OPLUS_CHG
source "$(KCONFIG_EXT_PREFIX)v1/Kconfig.ddk"
endif

config OPLUS_CHARGER_WIRELESS_RA9530
	bool "OPLUS charger wireless pen 9530 ic"
	help
	  Say Y to include support

endif #OPLUS_CHARGER

source "$(KCONFIG_EXT_PREFIX)test-kit/Kconfig.ddk"
source "$(KCONFIG_EXT_PREFIX)debug-kit/Kconfig.ddk"
source "$(KCONFIG_EXT_PREFIX)config/Kconfig.ddk"
source "$(KCONFIG_EXT_PREFIX)wireless_pen/Kconfig.ddk"
source "$(KCONFIG_EXT_PREFIX)gauge_i2c_rst/Kconfig.ddk"
source "$(KCONFIG_EXT_PREFIX)oplus_chg_symbol/Kconfig.ddk"

config OPLUS_FEATURE_OLC
        tristate "Add for oplus log core"
        default n
        help
          Add for oplus log core.

config OPLUS_MT6789_CHARGER
	bool "MTK6789 support"
	help
	  Say Y here to declare MTK6789 support
```

## vendor/oplus/kernel/charger/bazel/oplus_chg_symbol/Kconfig.ddk
```kconfig
config OPLUS_CHG_SYMBOL
        tristate "Add for oplus chg v1 and v2 compatible"
        default n
        help
          Add for oplus chg v1 and v2 compatible.
```

## vendor/oplus/kernel/charger/pd_ext/Kconfig
```kconfig
#
# TypeC Port Controller Device Configuration
#
config OPLUS_TCPC
        tristate "TypeC Port Controller Device Class"
        depends on TCPC_CLASS
        depends on USB_POWER_DELIVERY
        help
          Say Y to enable
          Typec Portcd
          Controller Device
          Class

config TCPC_CLASS
	tristate "TypeC Port Controller Device Class"
	select MTK_USB_TYPEC
	select RT_REGMAP
	select TYPEC
	help
	  Say Y to enable
	  Typec Port
	  Controller Device
	  Class

config USB_POWER_DELIVERY
	tristate "Support USB power delivery Function"
	depends on TCPC_CLASS
	default n
	help
	  Say Y to enable
	  USB
	  Power Delivery
	  support

config TCPC_ET7303
	tristate "Richtek ET7303 TypeC port Controller Driver"
	depends on TCPC_CLASS
	default n
	help
	  Say Y to enable
	  Richtek ET7303
	  TypeC port Controller
	  Driver

config TCPC_RT1711H
	tristate "Richtek RT1711H TypeC port Controller Driver"
	depends on TCPC_CLASS
	default n
	help
	  Say Y to enable
	  Richtek RT1711H
	  TypeC port Controller
	  Driver

config TCPC_SGM7220
	tristate "SGM7220 TypeC port Controller Driver"
	depends on TCPC_CLASS
	default n
	help
	  Say Y to enable
	  SGM7220
	  TypeC port Controller
	  Driver

config TCPC_AW35616
	tristate "TCPC_AW35616 TypeC port Controller Driver"
	depends on TCPC_CLASS
	default n
	help
	  Say Y to enable
	  AW35616
	  TypeC port Controller
	  Driver

config TCPC_UPM7610
	tristate "Unisemipower UPM7610 TypeC port Controller Driver"
	depends on TCPC_CLASS
	default n
	help
	  Say Y to enable
	  Unisemipower UPM7610
	  TypeC port Controller
	  Driver

config TCPC_CPS8851
	tristate "TCPC_CPS8851 TypeC port Controller Driver"
	depends on TCPC_CLASS
	default n
	help
	  Say Y to enable
	  CPS8851
	  TypeC port Controller
	  Driver

config USB_PD_VBUS_STABLE_TOUT
	int "PD VBUS Stable Timeout"
	depends on USB_POWER_DELIVERY
	range 0 1000                       # >= 0,  <= 1000
	default 125
	help
	  Setup a timeout value (ms)
	  for
	  VBUS change
	  stable

config PD_DBG_INFO
	tristate "PD debug information"
	depends on TCPC_CLASS
	default y
	help
	  Say Y to enable PD debug
	  information
	  Say N to disable
```
