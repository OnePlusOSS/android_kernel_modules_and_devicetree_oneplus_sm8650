/dts-v1/;
/plugin/;

#include <dt-bindings/clock/qcom,gcc-pineapple.h>
#include <dt-bindings/clock/qcom,camcc-pineapple.h>
#include <dt-bindings/interconnect/qcom,pineapple.h>
#include <dt-bindings/interrupt-controller/arm-gic.h>
#include <dt-bindings/regulator/qcom,rpmh-regulator-levels.h>
#include "../pineapple-camera-v2.dtsi"
#include "enzo_camera_overlay_common.dtsi"
#include "enzo_camera_main_actuator_pid.dtsi"
/ {
	model = "Qualcomm Technologies, Inc. Pineapple enzo MTP";
	compatible = "qcom,pineapple-mtp", "qcom,pineapple", "qcom,mtp";
	oplus,project-id = <23607>;
};
